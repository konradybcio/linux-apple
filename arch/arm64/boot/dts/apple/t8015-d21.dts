// SPDX-License-Identifier: GPL-2.0+ OR MIT
/*
 * Apple iPhone 8 Plus (Global), D21 iPhone10,2 (A1864/A1897/A1898)
 * Copyright (c) 2022, Konrad Dybcio <konrad.dybcio@somainline.org>
 */

/dts-v1/;

#include "t8015-8plus.dtsi"

/ {
	model = "Apple iPhone 8 Plus (Global)";
	compatible = "apple,d21", "apple,t8015", "apple,arm-platform";
};
