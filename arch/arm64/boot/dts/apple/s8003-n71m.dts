// SPDX-License-Identifier: GPL-2.0+ OR MIT
/*
 * Apple iPhone 6S (TSMC), N71m, iPhone8,1 (A1633/A1688/A1691/A1700)
 * Copyright (c) 2022, Konrad Dybcio <konrad.dybcio@somainline.org>
 */

/dts-v1/;

#include "s8003.dtsi"
#include "s800x-6s.dtsi"

/ {
	model = "Apple iPhone 6S (S8003)";
	compatible = "apple,n71m", "apple,s8003", "apple,arm-platform";
};
