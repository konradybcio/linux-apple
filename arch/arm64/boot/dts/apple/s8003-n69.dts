// SPDX-License-Identifier: GPL-2.0+ OR MIT
/*
 * Apple iPhone SE (TSMC), N69, iPhone8,4 (A1662/A1723/A1724)
 * Copyright (c) 2022, Konrad Dybcio <konrad.dybcio@somainline.org>
 */

/dts-v1/;

#include "s8003.dtsi"
#include "s800x-se.dtsi"

/ {
	model = "Apple iPhone SE (S8003)";
	compatible = "apple,n69", "apple,s8003", "apple,arm-platform";
};
