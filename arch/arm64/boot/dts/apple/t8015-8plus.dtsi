// SPDX-License-Identifier: GPL-2.0+ OR MIT
/*
 * Apple iPhone 8 Plus common device tree
 *
 * Copyright (c) 2022, Konrad Dybcio <konrad.dybcio@somainline.org>
 */

/* The 8 Plus has minor differences like 1 more camera, 1 GiB of RAM more and a bigger display. */
#include "t8015-8.dtsi"

/ {
};

&system_memory {
	/* The 8 Plus comes with 3 GiB of RAM. */
	reg = <0x8 0 0 0xc0000000>;
};
