// SPDX-License-Identifier: GPL-2.0+ OR MIT
/*
 * Apple iPad Air 2 (Cellular), J82, iPad5,4 (A1567)
 * Copyright (c) 2022, Konrad Dybcio <konrad.dybcio@somainline.org>
 */

/dts-v1/;

#include "t7001-air2.dtsi"

/ {
	model = "Apple iPad Air 2 (Cellular)";
	compatible = "apple,j82", "apple,t7001", "apple,arm-platform";
};
