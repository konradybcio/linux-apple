// SPDX-License-Identifier: GPL-2.0+ OR MIT
/*
 * Apple iPhone 7 (Intel), D101, iPhone9,3 (A1660/A1778/A1779/A1780)
 * Copyright (c) 2022, Konrad Dybcio <konrad.dybcio@somainline.org>
 */

/dts-v1/;

#include "t8010-7.dtsi"

/ {
	model = "Apple iPhone 7 (Intel)";
	compatible = "apple,d101", "apple,t8010", "apple,arm-platform";
};
