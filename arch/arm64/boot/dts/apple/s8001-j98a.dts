// SPDX-License-Identifier: GPL-2.0+ OR MIT
/*
 * Apple iPad Pro (12.9-inch) (Wi-Fi), J98a, iPad6,7 (A1584)
 * Copyright (c) 2022, Konrad Dybcio <konrad.dybcio@somainline.org>
 */

/dts-v1/;

#include "s8001-pro.dtsi"

/ {
	model = "Apple iPad Pro (12.9-inch) (Wi-Fi)";
	compatible = "apple,j98a", "apple,s8001", "apple,arm-platform";
};
