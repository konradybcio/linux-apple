// SPDX-License-Identifier: GPL-2.0+ OR MIT
/*
 * Apple iPhone 5S (LTE), N53AP, iPhone6,2 (A1457/A1518/A1528/A1530)
 * Copyright (c) 2022, Konrad Dybcio <konrad.dybcio@somainline.org>
 */

/dts-v1/;

#include "s5l8960x-5s.dtsi"

/ {
	model = "Apple iPhone 5S (LTE)";
	compatible = "apple,n53ap", "apple,s5l8960x", "apple,arm-platform";
};
