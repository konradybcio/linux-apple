// SPDX-License-Identifier: GPL-2.0+ OR MIT
/*
 * Apple iPad Mini 3 (Cellular), J86m, iPad4,8 (A1600)
 * Copyright (c) 2022, Konrad Dybcio <konrad.dybcio@somainline.org>
 */

/dts-v1/;

#include "s5l8960x-j86.dts"
#include "s5l8960x-mini3.dtsi"

/ {
	model = "Apple iPad Mini 3 (Cellular)";
	compatible = "apple,j86m", "apple,s5l8960x", "apple,arm-platform";
};
