// SPDX-License-Identifier: GPL-2.0+ OR MIT
/*
 * Apple iPhone 8 (GSM), D20 iPhone10,4 (A1905)
 * Copyright (c) 2022, Konrad Dybcio <konrad.dybcio@somainline.org>
 */

/dts-v1/;

#include "t8015-8.dtsi"

/ {
	model = "Apple iPhone 8 (GSM)";
	compatible = "apple,d201", "apple,t8015", "apple,arm-platform";
};
