// SPDX-License-Identifier: GPL-2.0+ OR MIT
/*
 * Apple iPad 5 (Wi-Fi) (TSMC), J71t, iPad6,11 (A1822)
 * Copyright (c) 2022, Konrad Dybcio <konrad.dybcio@somainline.org>
 */

/dts-v1/;

#include "s8003.dtsi"
#include "s800x-ipad5.dtsi"

/ {
	model = "Apple iPad 5 (Wi-Fi) (S8003)";
	compatible = "apple,j71t", "apple,s8003", "apple,arm-platform";
};
