// SPDX-License-Identifier: GPL-2.0+ OR MIT
/*
 * Apple iPad Pro 2 (10.5-inch) (Wi-Fi), J207, iPad7,3 (A1701)
 * Copyright (c) 2022, Konrad Dybcio <konrad.dybcio@somainline.org>
 */

/dts-v1/;

#include "t8011-pro2.dtsi"

/ {
	model = "Apple iPad Pro 2 (10.5-inch) (Wi-Fi)";
	compatible = "apple,j207", "apple,t8011", "apple,arm-platform";
};
