// SPDX-License-Identifier: GPL-2.0+ OR MIT
/*
 * Apple iPad Mini 4 common device tree
 *
 * Copyright (c) 2022, Konrad Dybcio <konrad.dybcio@somainline.org>
 */

#include "t7000.dtsi"

/ {
};

&serial0 {
	status = "okay";
};

&system_memory {
	/* The Mini 4 comes with 2 GiB of RAM. */
	reg = <0x8 0 0 0x80000000>;
};
