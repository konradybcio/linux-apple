// SPDX-License-Identifier: GPL-2.0+ OR MIT
/*
 * Apple iPad 6 (Wi-Fi), J71b, iPad7,5 (A1893)
 * Copyright (c) 2022, Konrad Dybcio <konrad.dybcio@somainline.org>
 */

/dts-v1/;

#include "t8010-ipad6.dtsi"

/ {
	model = "Apple iPad 6 (Wi-Fi)";
	compatible = "apple,j71b", "apple,t8010", "apple,arm-platform";
};
