// SPDX-License-Identifier: GPL-2.0+ OR MIT
/*
 * Apple iPad Air (Cellular, China), J73AP, iPad4,2 (A1476)
 * Copyright (c) 2022, Konrad Dybcio <konrad.dybcio@somainline.org>
 */

/dts-v1/;

#include "s5l8960x-air1.dtsi"

/ {
	model = "Apple iPad Air (Cellular, China)";
	compatible = "apple,j73ap", "apple,s5l8960x", "apple,arm-platform";
};
