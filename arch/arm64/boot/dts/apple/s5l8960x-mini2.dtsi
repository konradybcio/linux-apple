// SPDX-License-Identifier: GPL-2.0+ OR MIT
/*
 * Apple iPad Mini 2 common device tree
 * Based on A7 (APL0698), up to 1.3GHz
 *
 * Copyright (c) 2022, Konrad Dybcio <konrad.dybcio@somainline.org>
 */

#include "s5l8960x.dtsi"

/ {
};

&serial0 {
	status = "okay";
};
