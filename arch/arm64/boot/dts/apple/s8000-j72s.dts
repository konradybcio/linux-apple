// SPDX-License-Identifier: GPL-2.0+ OR MIT
/*
 * Apple iPad 5 (Cellular) (Samsung), J72s, iPad6,12 (A1823)
 * Copyright (c) 2022, Konrad Dybcio <konrad.dybcio@somainline.org>
 */

/dts-v1/;

#include "s8000.dtsi"
#include "s800x-ipad5.dtsi"

/ {
	model = "Apple iPad 5 (Cellular) (S8000)";
	compatible = "apple,j72s", "apple,s8000", "apple,arm-platform";
};
