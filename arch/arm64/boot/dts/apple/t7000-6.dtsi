// SPDX-License-Identifier: GPL-2.0+ OR MIT
/*
 * Apple iPhone 6 / 6 Plus common device tree
 * Copyright (c) 2022, Konrad Dybcio <konrad.dybcio@somainline.org>
 */

#include "t7000.dtsi"

/ {
};

&serial0 {
	status = "okay";
};
