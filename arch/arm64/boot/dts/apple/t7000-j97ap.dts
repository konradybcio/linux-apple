// SPDX-License-Identifier: GPL-2.0+ OR MIT
/*
 * Apple iPad Mini 4 (Cellular), J97AP, iPad5,2 (A1550)
 * Copyright (c) 2022, Konrad Dybcio <konrad.dybcio@somainline.org>
 */

/dts-v1/;

#include "t7000-mini4.dtsi"

/ {
	model = "Apple iPad Mini 4 (Cellular)";
	compatible = "apple,j97ap", "apple,t7000", "apple,arm-platform";
};
