// SPDX-License-Identifier: GPL-2.0+ OR MIT
/*
 * Apple iPad Air  common device tree
 * Based on A7 (APL5698), up to 1.4GHz
 *
 * Copyright (c) 2022, Konrad Dybcio <konrad.dybcio@somainline.org>
 */

#include "s5l8960x.dtsi"

/ {
};

&serial0 {
	status = "okay";
};
