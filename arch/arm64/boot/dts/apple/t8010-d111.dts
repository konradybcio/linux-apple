// SPDX-License-Identifier: GPL-2.0+ OR MIT
/*
 * Apple iPhone 7 Plus (Intel), D111, iPhone9,4 (A1661/A1784/A1785/A1786)
 * Copyright (c) 2022, Konrad Dybcio <konrad.dybcio@somainline.org>
 */

/dts-v1/;

#include "t8010-7.dtsi"

/ {
	model = "Apple iPhone 7 Plus (Intel)";
	compatible = "apple,d111", "apple,t8010", "apple,arm-platform";
};
