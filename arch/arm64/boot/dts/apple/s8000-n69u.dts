// SPDX-License-Identifier: GPL-2.0+ OR MIT
/*
 * Apple iPhone SE (Samsung), N69u, iPhone8,4 (A1662/A1723/A1724)
 * Copyright (c) 2022, Konrad Dybcio <konrad.dybcio@somainline.org>
 */

/dts-v1/;

#include "s8000.dtsi"
#include "s800x-se.dtsi"

/ {
	model = "Apple iPhone SE (S8000)";
	compatible = "apple,n69u", "apple,s8000", "apple,arm-platform";
};
