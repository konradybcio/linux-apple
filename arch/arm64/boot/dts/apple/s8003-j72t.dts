// SPDX-License-Identifier: GPL-2.0+ OR MIT
/*
 * Apple iPad 5 (Cellular) (TSMC), J72t, iPad6,12 (A1823)
 * Copyright (c) 2022, Konrad Dybcio <konrad.dybcio@somainline.org>
 */

/dts-v1/;

#include "s8003.dtsi"
#include "s800x-ipad5.dtsi"

/ {
	model = "Apple iPad 5 (Cellular) (S8003)";
	compatible = "apple,j72t", "apple,s8003", "apple,arm-platform";
};
